## build/conf/bblayers.conf
```bitbake
# changes incompatibly
POKY_BBLAYERS_CONF_VERSION = "2"

BBPATH = "${TOPDIR}"
BBFILES ?= ""

BBLAYERS ?= " \
  /home/majo/Learn/yocto/poky/meta \
  /home/majo/Learn/yocto/poky/meta-poky \
  /home/majo/Learn/yocto/poky/meta-yocto-bsp \
  /home/majo/Learn/yocto/poky/meta-openembedded/meta-oe \
  /home/majo/Learn/yocto/poky/meta-openembedded/meta-python \
  /home/majo/Learn/yocto/poky/meta-openembedded/meta-multimedia \
  /home/majo/Learn/yocto/poky/meta-openembedded/meta-networking \
  /home/majo/Learn/yocto/poky/meta-rockchip \
  /home/majo/Learn/yocto/poky/meta-camera \
  "
```
